.equ NOTE_32	= 1					; 32th note
.equ NOTE_24	= (NOTE_32 << 1)*1.5; 16th note
.equ NOTE_16	= (NOTE_32 << 1)	; 16th note
.equ NOTE_12	= (NOTE_32 << 2)*1.5; eighth note
.equ NOTE_8		= (NOTE_32 << 2)	; eighth note
.equ NOTE_4		= (NOTE_32 << 3)	; quater note
.equ NOTE_2		= (NOTE_32 << 4)	; half note
.equ NOTE_WL	= (NOTE_32 << 5)	; whole note
.equ NOTE_DWL	= (NOTE_32 << 6)	; double whole note

.equ TONE_NONE	= 0
.equ TONE_0G	= 255	; G
.equ TONE_0GS	= 241	; G#
.equ TONE_0A	= 227	; A
.equ TONE_0AS	= 215	; A#
.equ TONE_0B	= 202	; B
.equ TONE_1C	= 191	; C
.equ TONE_1CS	= 180	; C#
.equ TONE_1D	= 170	; D
.equ TONE_1DS	= 161	; C#
.equ TONE_1E	= 152	; E
.equ TONE_1F	= 143	; F
.equ TONE_1FS	= 135	; F#
.equ TONE_1G	= 128	; G
.equ TONE_1GS	= 120	; G#
.equ TONE_1A	= 114	; A, 440Hz
.equ TONE_1AS	= 107	; A#
.equ TONE_1B	= 101	; B
.equ TONE_2C	= 96	; C
.equ TONE_2CS	= 90	; C#
.equ TONE_2D	= 85	; D
.equ TONE_2DS	= 80	; D#
.equ TONE_2E	= 76	; E
.equ TONE_2F	= 72	; F
.equ TONE_2FS	= 68	; F#
.equ TONE_2G	= 64	; G
.equ TONE_2GS	= 60	; G#
.equ TONE_2A	= 57	; A
.equ TONE_2AS	= 54	; A#
.equ TONE_2B	= 51	; B
.equ TONE_3C	= 48	; C
.equ TONE_3CS	= 45	; C#
.equ TONE_3D	= 43	; D
.equ TONE_3DS	= 40	; D#
.equ TONE_3E	= 38	; E
.equ TONE_3F	= 36	; F
.equ TONE_3FS	= 34	; F#
.equ TONE_3G	= 32	; G
.equ TONE_3GS	= 30	; G#
.equ TONE_3A	= 28	; A
.equ TONE_3AS	= 27	; A#
.equ TONE_3B	= 25	; B
.equ TONE_4C	= 24	; C


